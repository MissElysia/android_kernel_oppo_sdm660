## drivers/input/touchscreen/oppo_touchscreen/Kconfig
```kconfig
config TOUCHPANEL_OPPO
	bool "OPPO tp module"
	help
	  Say Y here if you have touchscreen module.

config TOUCHPANEL_SYNAPTICS
#	default y
	bool "TP Synaptics_IC enable or not for OPPO"
	---help---
	say Y to enable driver for Touchpanel using Synaptics_IC

source "drivers/input/touchscreen/oppo_touchscreen/util_interface/Kconfig"

if TOUCHPANEL_SYNAPTICS
source "drivers/input/touchscreen/oppo_touchscreen/Synaptics/Kconfig"
endif
```
